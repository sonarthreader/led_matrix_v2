

uint32_t leddefault[M_WIDTH*M_HEIGHT] = // initial values for LED panel
{
0x673ab7, 0x673ab7, 0x673ab7, 0x673ab7, 0x673ab7, 0x673ab7, 0x000000, 0x000000, 0x000000, 0x000000, 0x2196f3, 0x2196f3, 0x2196f3, 0x2196f3, 0x2196f3, 0x2196f3,
0x673ab7, 0x673ab7, 0x673ab7, 0x673ab7, 0x000000, 0x000000, 0xffeb3b, 0xffeb3b, 0xffeb3b, 0xffeb3b, 0x000000, 0x000000, 0x2196f3, 0x2196f3, 0x2196f3, 0x2196f3,
0x673ab7, 0x673ab7, 0x673ab7, 0x000000, 0xffeb3b, 0xffeb3b, 0xffeb3b, 0xffeb3b, 0xffeb3b, 0xffeb3b, 0xffeb3b, 0xffeb3b, 0x000000, 0x2196f3, 0x2196f3, 0x2196f3,
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0xb71c1c, 0xb71c1c, 0xb71c1c, 0xb71c1c, 0xb71c1c, 0xb71c1c, 0x000000, 0x000000, 0x000000, 0x000000, 0x4caf50, 0x4caf50, 0x4caf50, 0x4caf50, 0x4caf50, 0x4caf50
};

void printArray(uint32_t Panel[], int DelayTime) {
  for (int i = 0; i < M_WIDTH * M_HEIGHT; i++) {
    int x = i % M_WIDTH;
    int y = M_HEIGHT - i / M_HEIGHT -1;
    leds(x,y) = Panel[i];
  }
  FastLED.setBrightness(pow(2, brightness) - 1);
  FastLED.show();
  delay(DelayTime);
}

void setupLEDMatrix() {
  // instantiate FastLED
  FastLED.addLeds<WS2812B, DATA_PIN, GRB>(leds[0], M_WIDTH * M_HEIGHT);
  FastLED.clear();
  
  // instantiate LEDText
  ScrollingMsg.SetFont(MatriseFontData);
  ScrollingMsg.Init(&leds, leds.Width(), ScrollingMsg.FontHeight() + 1, 0, 0);
  ScrollingMsg.SetTextColrOptions(COLR_RGB | COLR_SINGLE, 0xff, 0xff, 0xff);
  ScrollingMsg.SetScrollDirection(SCROLL_LEFT);
  ScrollingMsg.SetFrameRate(160 / M_WIDTH);       // Faster for larger matrices  
  printArray(leddefault, 1000);
}

void showLEDText(String LEDText) {
  char* dynCharArray;
  dynCharArray = new char[sizeof(LEDText)];
  
  if (dynCharArray == nullptr) {
    Serial.println("ERROR: memory could not be assigned");
  }
  LEDText.toCharArray(dynCharArray, sizeof(LEDText) + 1);
  // debug sizes
  Serial.println(LEDText);
  Serial.println(sizeof(LEDText));
  Serial.println(dynCharArray);
  Serial.println(strlen(dynCharArray));
  
  ScrollingMsg.SetText((unsigned char *)dynCharArray, strlen(dynCharArray));
  while(ScrollingMsg.UpdateText() == 0) {
    FastLED.show();  
  } 
} // showLEDText
